/*
 * Copyright (C) 2012 Texas Instruments Incorporated - http://www.ti.com/
 *
 * This program is free software; you can redistribute it and/or modify
 * it under the terms of the GNU General Public License version 2 as
 * published by the Free Software Foundation.
 */

&ocp {
	pwm_test_P8_36 {
		compatible	= "pwm_test";
		pwms 		= <&ehrpwm1 0 500000 1>;
		pwm-names 	= "PWM_P8_36";
		pinctrl-names	= "default";
		pinctrl-0	= <&pwm_P8_36>;
		enabled		= <1>;
		duty		= <0>;
		status 		= "okay";
	};
};
