/*
 * Copyright (C) 2012 Texas Instruments Incorporated - http://www.ti.com/
 *
 * This program is free software; you can redistribute it and/or modify
 * it under the terms of the GNU General Public License version 2 as
 * published by the Free Software Foundation.
 */

&ocp {
	/* i2c2 */
	P9_19_pinmux {
		mode = "i2c";
	};
	P9_20_pinmux {
		mode = "i2c";
	};
};

&i2c2 {
	status = "okay";
	pinctrl-names = "default";
	/* pinctrl-0 = <>; */
	pinctrl-0 = <&i2c2_pins>;
	clock-frequency = <100000>;
};
